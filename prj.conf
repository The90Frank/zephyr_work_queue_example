## CMakeLists.txt
```
# SPDX-License-Identifier: Apache-2.0
cmake_minimum_required(VERSION 3.20.0)

find_package(Zephyr REQUIRED HINTS $ENV{ZEPHYR_BASE})
project(work_queue)

FILE(GLOB app_sources src/*.c)
target_sources(app PRIVATE ${app_sources})
```

## prj.conf
```kconfig
CONFIG_LOG=y
CONFIG_THREAD_NAME=y
CONFIG_ASSERT=y
CONFIG_LOG_MODE_MINIMAL=y
CONFIG_PRINTK_SYNC=y
CONFIG_ZBUS=y
CONFIG_ZBUS_LOG_LEVEL_INF=y
CONFIG_GPIO=y
```

## src/main.c
```c
#include "consumer.h"

int main(void)
{
   init_led();
   return 0;
}
```

## src/consumer.c
```c
#include "messages.h"
#include "consumer.h"

#include <stdint.h>

#include <zephyr/kernel.h>
#include <zephyr/logging/log.h>
#include <zephyr/sys/util_macro.h>
#include <zephyr/zbus/zbus.h>

#include <zephyr/kernel.h>
#include <zephyr/device.h>
#include <zephyr/drivers/gpio.h>
#include <zephyr/sys/printk.h>
#include <zephyr/sys/__assert.h>

#define LED0_NODE DT_ALIAS(led0)
struct gpio_dt_spec led = GPIO_DT_SPEC_GET_OR(LED0_NODE, gpios, {0});

void init_led(void)
{
   uint32_t ret = 0;
   if (!device_is_ready(led.port))
   {
      printk("Error: %s device is not ready\n", led.port->name);
      return;
   }

   ret = gpio_pin_configure_dt(&led, GPIO_OUTPUT);
   if (ret != 0)
   {
      printk("Error %d: failed to configure pin %d (LED '%d')\n",
             ret, led.pin, 0);
      return;
   }
}

LOG_MODULE_DECLARE(zbus, CONFIG_ZBUS_LOG_LEVEL);

ZBUS_CHAN_DEFINE(custom_data_chan,  /* Name */
                 struct custom_msg, /* Message type */

                 NULL, /* Validator */
                 NULL, /* User data */
                 ZBUS_OBSERVERS(
                     thread_handler_sub, fast_handler_lis), /* observers */
                 ZBUS_MSG_INIT(0)                           /* Initial value {0} */
);

/* Thread handler */

ZBUS_SUBSCRIBER_DEFINE(thread_handler_sub, 4);

static void thread_handler_task(void)
{
   const struct zbus_channel *chan;

   while (!zbus_sub_wait(&thread_handler_sub, &chan, K_FOREVER))
   {
      struct custom_msg msg;

      zbus_chan_read(chan, &msg, K_MSEC(200));

      LOG_INF("Custom msg processed by Thread handler: msg = %u",
              msg.msg);

      if (msg.msg % 2 == 0)
      {
         gpio_pin_set(led.port, led.pin, 1);
      }
      else
      {
      }
   }
}

K_THREAD_DEFINE(thread_handler_id, 1024, thread_handler_task, NULL, NULL, NULL, 3, 0, 0);

/* Fast handler */

static void fh_cb(const struct zbus_channel *chan)
{
   const struct custom_msg *msg = zbus_chan_const_msg(chan);

   LOG_INF("Custom msg processed by Fast handler: msg = %u",
           msg->msg);

   if (msg->msg % 2 == 0)
   {
   }
   else
   {
      gpio_pin_set(led.port, led.pin, 0);
   }
}

ZBUS_LISTENER_DEFINE(fast_handler_lis, fh_cb);
```

## src/consumer.h
```c
#ifndef SRC_CONSUMER_H_
#define SRC_CONSUMER_H_

void init_led(void);

#endif /* SRC_CONSUMER_H_ */
```

## src/messages.h
```c
#ifndef _MESSAGES_H_
#define _MESSAGES_H_
#include <stdint.h>

struct custom_msg
{
   uint32_t msg;
};

#endif /* _MESSAGES_H_ */
```

## src/producer.c
```c
#include "messages.h"

#include <zephyr/logging/log.h>
#include <zephyr/zbus/zbus.h>
LOG_MODULE_DECLARE(zbus, CONFIG_ZBUS_LOG_LEVEL);

ZBUS_CHAN_DECLARE(custom_data_chan);

void peripheral_thread(void)
{
   struct custom_msg sm = {0};

   while (1)
   {
      sm.msg += 1;

      LOG_INF("Sending custom data {%u}...", sm.msg);

      zbus_chan_pub(&custom_data_chan, &sm, K_MSEC(1000));

      k_msleep(500);
   }
}

K_THREAD_DEFINE(peripheral_thread_id, 1024, peripheral_thread, NULL, NULL, NULL, 5, 0, 0);
```
